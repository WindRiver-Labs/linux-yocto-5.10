## Documentation/devicetree/bindings/mmc/fsl-imx-esdhc.txt
```
* Freescale Enhanced Secure Digital Host Controller (eSDHC) for i.MX

The Enhanced Secure Digital Host Controller on Freescale i.MX family
provides an interface for MMC, SD, and SDIO types of memory cards.

Required properties:
- compatible : Should be "fsl,<chip>-esdhc"
- reg : Should contain eSDHC registers location and length
- interrupts : Should contain eSDHC interrupt

Optional properties:
- fsl,card-wired : Indicate the card is wired to host permanently
- fsl,cd-internal : Indicate to use controller internal card detection
- fsl,wp-internal : Indicate to use controller internal write protection
- cd-gpios : Specify GPIOs for card detection
- wp-gpios : Specify GPIOs for write protection
- auto-cmd23-broken: disable the ACMD23 function of USDHC.
- This is required for eMMC on imx6qpdl/imx6sx/imx7d when it use ADMA mode. Because
- for these SoC, it do not support the ACMD23 completely, only take the 16 bit block
- count from the 0x4 register (BLK_ATT) as argument for the ACMD23, the upper 16 bit
- of the CMD23's argument is ignored. This will impact the reliable write operation
- and the RPMB block write operation, because these operations need to set the bit 31
- of the CMD23's argument. SDMA mode will default disable the ACMD23 mode. SD card do
- not has this limitation on these SoCs.

Examples:

esdhc@70004000 {
	compatible = "fsl,imx51-esdhc";
	reg = <0x70004000 0x4000>;
	interrupts = <1>;
	fsl,cd-internal;
	fsl,wp-internal;
};

esdhc@70008000 {
	compatible = "fsl,imx51-esdhc";
	reg = <0x70008000 0x4000>;
	interrupts = <2>;
	cd-gpios = <&gpio0 6 0>; /* GPIO1_6 */
	wp-gpios = <&gpio0 5 0>; /* GPIO1_5 */
};
```

## drivers/mxc/Kconfig
```kconfig
# drivers/mxc/Kconfig

if ARCH_MXC

menu "MXC support drivers"

if ARM64
source "drivers/mxc/hantro/Kconfig"
source "drivers/mxc/hantro_845/Kconfig"
source "drivers/mxc/hantro_845_h1/Kconfig"
source "drivers/mxc/hantro_vc8000e/Kconfig"
source "drivers/mxc/gpu-viv/Kconfig"
source "drivers/mxc/xuvi/Kconfig"
endif

source "drivers/mxc/vpu/Kconfig"

endmenu

endif
```
